/*
 * Copyright (C) 2015 Jumpnow Technologies, LLC - http://jumpnowtek.com
 *
 * This program is free software; you can redistribute it and/or modify
 * it under the terms of the GNU General Public License version 2 as
 * published by the Free Software Foundation.
 */

&am33xx_pinmux {
	can0_pins: can0_pins {
		pinctrl-single,pins = <
			0x17c (PIN_INPUT_PULLUP | MUX_MODE2)   /* P9.19, dcan0_rx */
			0x178 (PIN_OUTPUT_PULLUP | MUX_MODE2)  /* P9.20, dcan0_tx */
		>;
	};
};

&can0 {
	status = "okay";
	pinctrl-names = "default";
	pinctrl-0 = <&can0_pins>;
};
