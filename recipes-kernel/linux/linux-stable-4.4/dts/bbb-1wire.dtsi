/*
 * Copyright (C) 2015 Jumpnow Technologies, LLC - http://jumpnowtek.com
 *
 * This program is free software; you can redistribute it and/or modify
 * it under the terms of the GNU General Public License version 2 as
 * published by the Free Software Foundation.
 */

&am33xx_pinmux {
	onewire_pin: onewire_pin {
		pinctrl-single,pins = <
			0x48 (PIN_INPUT_PULLUP | MUX_MODE7)     /* P9.14, gpio1[18] */
		>;
	};
};

/ {
	onewire@0 {
		status = "okay";
		compatible = "w1-gpio";
		pinctrl-names = "default";
		pinctrl-0 = <&onewire_pin>;
		gpios = <&gpio1 18 0>;
	};
};
