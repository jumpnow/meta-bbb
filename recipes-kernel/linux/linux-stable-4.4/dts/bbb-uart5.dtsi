/*
 * Copyright (C) 2015 Jumpnow Technologies, LLC - http://jumpnowtek.com
 *
 * This program is free software; you can redistribute it and/or modify
 * it under the terms of the GNU General Public License version 2 as
 * published by the Free Software Foundation.
 */

&am33xx_pinmux {
	uart5_pins: uart5_pins {
		pinctrl-single,pins = <
			0xc4 (PIN_INPUT_PULLUP | MUX_MODE4)     /* P8.38, uart5_rxd */
			0xc0 (PIN_OUTPUT_PULLDOWN | MUX_MODE4)  /* P8.37, uart5_txd */
		>;
	};
};

&uart5 {
	status = "okay";
	pinctrl-names = "default";
	pinctrl-0 = <&uart5_pins>;
};
