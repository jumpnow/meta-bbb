/*
 * Copyright (C) 2015 Jumpnow Technologies, LLC - http://jumpnowtek.com
 *
 * This program is free software; you can redistribute it and/or modify
 * it under the terms of the GNU General Public License version 2 as
 * published by the Free Software Foundation.
 */

&am33xx_pinmux {
	spi0_pins: spi0_pins {
		pinctrl-single,pins = <
			AM33XX_IOPAD(0x950, PIN_INPUT_PULLUP | MUX_MODE0)   /* P9.22, spi0_sclk */
			AM33XX_IOPAD(0x954, PIN_INPUT_PULLUP | MUX_MODE0)   /* P9.21, spi0_d0 (miso) */
			AM33XX_IOPAD(0x958, PIN_OUTPUT_PULLUP | MUX_MODE0)  /* P9.18, spi0_d1 (mosi) */
			AM33XX_IOPAD(0x95c, PIN_OUTPUT_PULLUP | MUX_MODE0)  /* P9.17, spi0_cs0 */
		>;
	};
};

&spi0 {
	status = "okay";
	id = <0>;
	pinctrl-names = "default";
	pinctrl-0 = <&spi0_pins>;

	spidev0_0: spidev0@0 {
		compatible = "generic,spi";
		reg = <0>;
		spi-max-frequency = <12000000>;
		/* spi-cpha; sets CPHA=1, default is CPHA=0 */
		/* spi-cpol; sets CPOL=1, default is CPOL=0 */
		/* spi-cs-high; default is spi cs low */
	};
};
