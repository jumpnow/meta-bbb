## conf/local.conf.sample
```bitbake
# Local configuration for beaglebone images
# Yocto Project 5.2 Poky distribution [walnascar] branch

DISTRO_FEATURES = "ext2 security systemd usbhost ${DISTRO_FEATURES_LIBC}"

DISTRO_FEATURES_BACKFILL_CONSIDERED += "pulseaudio sysvinit"

DISTRO_FEATURES:remove = "ptest"

INIT_MANAGER = "systemd"

MACHINE = "beaglebone"

# change this to modify fdtfile in boot.scr
KERNEL_DTB = "am335x-boneblack.dtb"

PREFERRED_PROVIDER_virtual/kernel = "linux-stable"

#DL_DIR = "/src/walnascar"
#SSTATE_DIR = "/oe5/bbb/sstate-cache"
#TMPDIR = "/oe5/bbb/tmp"

DISTRO = "poky"
PACKAGE_CLASSES = "package_ipk"

SDKMACHINE = "x86_64"

EXTRA_IMAGE_FEATURES = "empty-root-password allow-empty-password allow-root-login"

PATCHRESOLVE = "noop"
RM_OLD_IMAGE = "1"
INHERIT += "rm_work"
CONF_VERSION = "2"
```
