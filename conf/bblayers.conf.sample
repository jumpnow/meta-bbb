## conf/bblayers.conf.sample
```bitbake
# POKY_BBLAYERS_CONF_VERSION is increased each time build/conf/bblayers.conf
# changes incompatibly
POKY_BBLAYERS_CONF_VERSION = "2"

BBPATH = "${TOPDIR}"
BBFILES ?= ""

BBLAYERS ?= " \
  ${HOME}/poky-scarthgap/meta \
  ${HOME}/poky-scarthgap/meta-poky \
  ${HOME}/poky-scarthgap/meta-openembedded/meta-oe \
  ${HOME}/poky-scarthgap/meta-openembedded/meta-networking \
  ${HOME}/poky-scarthgap/meta-openembedded/meta-python \
  ${HOME}/poky-scarthgap/meta-security \
  ${HOME}/poky-scarthgap/meta-qt5 \
  ${HOME}/bbb/meta-bbb \
"
```

## conf/layer.conf
```bitbake
# We have a conf and classes directory, append to BBPATH
BBPATH .= ":${LAYERDIR}"

# We have a recipes directory, add to BBFILES
BBFILES += "${LAYERDIR}/recipes*/*/*.bb ${LAYERDIR}/recipes*/*/*.bbappend ${LAYERDIR}/images/*.bb"

BBFILE_COLLECTIONS += "meta-bbb"
BBFILE_PATTERN_meta-bbb := "^${LAYERDIR}/"
BBFILE_PRIORITY_meta-bbb = "8"
```

## conf/machine/beaglebone.conf
```bitbake
#@TYPE: Machine
#@NAME: Beaglebone 
#@DESCRIPTION: Machine configuration for the Beaglebone 

SOC_FAMILY = "ti335x"
TARGET_ARCH = "arm"

DEFAULTTUNE ?= "cortexa8hf-neon"
require conf/machine/include/arm/armv7a/tune-cortexa8.inc

PREFERRED_PROVIDER_virtual/kernel = "linux-stable"
KERNEL_IMAGETYPE = "zImage"

PREFERRED_PROVIDER_virtual/bootloader = "u-boot"
PREFERRED_PROVIDER_u-boot = "u-boot"
SPL_BINARY = "MLO"
UBOOT_SUFFIX = "img"
UBOOT_MACHINE = "am335x_evm_config"

EXTRA_IMAGEDEPENDS += "u-boot u-boot-scr"

SERIAL_CONSOLES = "115200:ttyS0 115200;ttyO0 115200:ttyAMA0"

IMAGE_FSTYPES = "tar.gz"

MACHINE_ESSENTIAL_EXTRA_RDEPENDS = "kernel-image kernel-devicetree kernel-modules"

MACHINE_FEATURES = "ext2 serial usbhost vfat"
```
